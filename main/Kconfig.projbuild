## main/Kconfig.projbuild
```kconfig
menu "Temperature Observer Config"

  menu "Temparature Observer Common"
    config ROOM
      string "Room of this observer"
      default "myRoom"
      help 
        Set the room for this temperature observer, is also be part of the publishing channel of this observer

    config NAME
      string "Name of this Observer"
      default "myObserver"
      help 
        Set the name for this temperature observer, is also be part of the publishing channel of this observer. Should be unique

    config MAXIMUN_CONNECT_RETRY
      int "Maximum retry"
        default 5
        help
          Set the Maximum retry count for trying to connect to wifi or mqtt broker
  
  endmenu

  menu "Temperature Wifi Default Config"

    config WIFI_SSID
      string "Wifi SSID"
      default ""
      help
        Wifi SSID network name

    config WIFI_PASSWORD
      string "Wifi Password"
      default ""
      help
        Password for wifi

  endmenu

  menu "Temperature MQTT Default Config"
    config BROKER_HOST
      string "Broker Host"
      default ""
      help
          The Broker hostname

    config BROKER_PORT
      int "Broker Port"
      default 1883
        help
          The port where to broker waits

    choice BROKER_TRANSPORT
      bool  "Broker Transport Protcol"
      default TRANSPORT_MQTT

      config TRANSPORT_MQTT
        bool "mqtt"

      config TRANSPORT_MQTTS
        bool "mqtts"

      config TRANSPORT_WS
        bool "ws"

      config TRANSPORT_WSS
        bool "wss"

    endchoice

  endmenu

endmenu
```
